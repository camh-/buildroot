## package/ncurses/Config.in
```kconfig
config BR2_PACKAGE_NCURSES
	bool "ncurses"
	help
	  The Ncurses (new curses) library is a free software emulation of
	  curses in System V Release 4.0, and more.

	  This package installs only a few vital termcap entries

	  http://www.gnu.org/software/ncurses/

if BR2_PACKAGE_NCURSES

config BR2_PACKAGE_NCURSES_WCHAR
	bool "enable wide char support"
	depends on BR2_USE_WCHAR
	# Build broken @ curses.priv.h with bad declarations
	depends on !(BR2_bfin && BR2_BINFMT_FLAT)
	help
	  Enable wide char & UTF-8 support in ncurses libraries

config BR2_PACKAGE_NCURSES_TARGET_PROGS
	bool "ncurses programs"
	help
	  Include ncurses programs in target (clear, reset, tput, ...)

config BR2_PACKAGE_NCURSES_ADDITIONAL_TERMINFO
	string "additional terminfo files to install to target"
	help
	  terminfo files to be installed to the target in addition to
	  the vital few normally installed.

	  The terminfo filenames should have the single letter path
	  prefix. e.g. t/tmux.

endif
```
